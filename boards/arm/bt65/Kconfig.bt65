## boards/arm/bt65/Kconfig.bt65
```kconfig
# SPDX-License-Identifier: MIT

config BOARD_BT65
	select SOC_NRF52840_QIAA
	select ZMK_BOARD_COMPAT
```

## boards/arm/ckp_bt65/Kconfig.ckp_bt65
```kconfig
# SPDX-License-Identifier: MIT

config BOARD_CKP_BT65
	select SOC_NRF52840_QIAA
	select ZMK_BOARD_COMPAT
```
